#include "st7796.h"

// 复位LCD
static void LCD_Reset(void)
{
  HAL_GPIO_WritePin(LCD_RES_PORT, LCD_RES_PIN, GPIO_PIN_SET);
  HAL_Delay(100);
  HAL_GPIO_WritePin(LCD_RES_PORT, LCD_RES_PIN, GPIO_PIN_RESET);
  HAL_Delay(100);
  HAL_GPIO_WritePin(LCD_RES_PORT, LCD_RES_PIN, GPIO_PIN_SET);
  HAL_Delay(100);
}

const uint8_t ASCII_8x16[][16] = {
	{0x00,0x00,0x00,0x18,0x24,0x42,0x42,0x42,0x42,0x42,0x42,0x42,0x24,0x18,0x00,0x00}, // 0 0x30
	{0x00, 0x00, 0x00, 0x08, 0x38, 0x08, 0x08, 0x08, 0x08, 0x08, 0x08, 0x08, 0x38, 0x3E, 0x00, 0x00},// "1",0
	{0x00, 0x00, 0x00, 0x3C, 0x42, 0x42, 0x42, 0x02, 0x04, 0x08, 0x10, 0x20, 0x42, 0x7E, 0x00, 0x00}, // "2",1
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	{0x00, 0x00, 0x00, 0x00, 0x00, 0x00, 0x7E, 0x44, 0x08, 0x10, 0x10, 0x22, 0x7E, 0x00, 0x00}, // "z",25
};

// 写命令
void LCD_WriteCmd(uint8_t cmd)
{
  LCD_CMD;  // 切换为命令模式
  HAL_GPIO_WritePin(LCD_CS_PORT, LCD_CS_PIN, GPIO_PIN_RESET);  // 片选使能
  HAL_SPI_Transmit(&hspi1, &cmd, 1, 100);  // 发送命令
  HAL_GPIO_WritePin(LCD_CS_PORT, LCD_CS_PIN, GPIO_PIN_SET);    // 取消片选
}

// 写数据
void LCD_WriteData(uint8_t data)
{
  LCD_DATA;  // 切换为数据模式
  HAL_GPIO_WritePin(LCD_CS_PORT, LCD_CS_PIN, GPIO_PIN_RESET);
  HAL_SPI_Transmit(&hspi1, &data, 1, 100);
  HAL_GPIO_WritePin(LCD_CS_PORT, LCD_CS_PIN, GPIO_PIN_SET);
}

// 设置显示窗口
void LCD_SetWindow(uint16_t x1, uint16_t y1, uint16_t x2, uint16_t y2)
{
  LCD_WriteCmd(0x2A);  // 列地址设置
  LCD_WriteData((x1 >> 8) & 0xFF);
  LCD_WriteData(x1 & 0xFF);
  LCD_WriteData((x2 >> 8) & 0xFF);
  LCD_WriteData(x2 & 0xFF);

  LCD_WriteCmd(0x2B);  // 行地址设置
  LCD_WriteData((y1 >> 8) & 0xFF);
  LCD_WriteData(y1 & 0xFF);
  LCD_WriteData((y2 >> 8) & 0xFF);
  LCD_WriteData(y2 & 0xFF);

  LCD_WriteCmd(0x2C);  // 开始写入GRAM
}

// 填充颜色
void LCD_Fill(uint16_t x1, uint16_t y1, uint16_t x2, uint16_t y2, uint16_t color)
{
  uint32_t i, len = (x2 - x1 + 1) * (y2 - y1 + 1);
  LCD_SetWindow(x1, y1, x2, y2);

  LCD_DATA;
  HAL_GPIO_WritePin(LCD_CS_PORT, LCD_CS_PIN, GPIO_PIN_RESET);
  for(i = 0; i < len; i++)
  {
    HAL_SPI_Transmit(&hspi1, (uint8_t*)&color, 2, 100);  // 16位颜色，分两次发送
  }
  HAL_GPIO_WritePin(LCD_CS_PORT, LCD_CS_PIN, GPIO_PIN_SET);
}

void LCD_FillScreen(uint16_t color){
	LCD_Fill(0, 0, LCD_WIDTH, LCD_HEIGHT, color);
}

// 绘制点
void LCD_DrawPoint(uint16_t x, uint16_t y, uint16_t color)
{
  // 检查坐标是否在屏幕范围内
  if(x >= LCD_WIDTH || y >= LCD_HEIGHT) return;

  LCD_SetWindow(x, y, x, y);
  LCD_DATA;
  HAL_GPIO_WritePin(LCD_CS_PORT, LCD_CS_PIN, GPIO_PIN_RESET);

  uint8_t color_data[2] = {(color >> 8) & 0xFF, color & 0xFF};
  HAL_SPI_Transmit(&hspi1, color_data, 2, 100);

  HAL_GPIO_WritePin(LCD_CS_PORT, LCD_CS_PIN, GPIO_PIN_SET);
}

// 绘制线（Bresenham算法）
void LCD_DrawLine(uint16_t x1, uint16_t y1, uint16_t x2, uint16_t y2, uint16_t color)
{
  int16_t dx = x2 - x1;
  int16_t dy = y2 - y1;
  int16_t sx = dx > 0 ? 1 : -1;
  int16_t sy = dy > 0 ? 1 : -1;

  dx = dx > 0 ? dx : -dx;
  dy = dy > 0 ? dy : -dy;

  int16_t x = x1, y = y1;
  int16_t err = dx - dy;

  while(1)
  {
    LCD_DrawPoint(x, y, color);

    if(x == x2 && y == y2) break;

    int16_t e2 = 2 * err;
    if(e2 > -dy)
    {
      err -= dy;
      x += sx;
    }
    if(e2 < dx)
    {
      err += dx;
      y += sy;
    }
  }
}

// 绘制矩形
void LCD_DrawRectangle(uint16_t x1, uint16_t y1, uint16_t x2, uint16_t y2, uint16_t color, uint8_t fill)
{
  if(fill)
  {
    // 填充矩形
    LCD_Fill(x1, y1, x2, y2, color);
  }
  else
  {
    // 绘制矩形边框
    LCD_DrawLine(x1, y1, x2, y1, color);  // 上边
    LCD_DrawLine(x1, y2, x2, y2, color);  // 下边
    LCD_DrawLine(x1, y1, x1, y2, color);  // 左边
    LCD_DrawLine(x2, y1, x2, y2, color);  // 右边
  }
}

// 绘制圆（中点圆算法）
void LCD_DrawCircle(uint16_t x0, uint16_t y0, uint16_t r, uint16_t color, uint8_t fill)
{
  int16_t x = 0, y = r;
  int16_t d = 3 - 2 * r;

  while(x <= y)
  {
    // 绘制8个对称点
    if(fill)
    {
      // 填充圆：绘制水平线
      LCD_DrawLine(x0 - x, y0 + y, x0 + x, y0 + y, color);
      LCD_DrawLine(x0 - x, y0 - y, x0 + x, y0 - y, color);
      if(x != y)
      {
        LCD_DrawLine(x0 - y, y0 + x, x0 + y, y0 + x, color);
        LCD_DrawLine(x0 - y, y0 - x, x0 + y, y0 - x, color);
      }
    }
    else
    {
      // 绘制圆轮廓
      LCD_DrawPoint(x0 + x, y0 + y, color);
      LCD_DrawPoint(x0 - x, y0 + y, color);
      LCD_DrawPoint(x0 + x, y0 - y, color);
      LCD_DrawPoint(x0 - x, y0 - y, color);
      LCD_DrawPoint(x0 + y, y0 + x, color);
      LCD_DrawPoint(x0 - y, y0 + x, color);
      LCD_DrawPoint(x0 + y, y0 - x, color);
      LCD_DrawPoint(x0 - y, y0 - x, color);
    }

    x++;
    if(d < 0)
    {
      d += 4 * x + 6;
    }
    else
    {
      d += 4 * (x - y) + 10;
      y--;
    }
  }
}

// 绘制字符
void LCD_DrawChar(uint16_t x, uint16_t y, uint8_t c, uint16_t color, uint16_t bg_color, uint8_t size)
{
  uint8_t i, j;
  uint8_t *p;

  // 检查字符是否在支持范围内
  if(c < 0x30 || c > 0x7A) return;

  // 计算字符在字模数组中的索引
  c -= 0x30;
  p = (uint8_t*)ASCII_8x16[c];

  // 循环绘制每个像素
  for(i = 0; i < 16; i++)
  {
    for(j = 0; j < 8; j++)
    {
      if(p[i] & (1 << (7 - j)))
      {
        // 放大字符
        if(size > 1)
        {
          LCD_Fill(x + j * size, y + i * size,
                  x + j * size + size - 1, y + i * size + size - 1,
                  color);
        }
        else
        {
          LCD_DrawPoint(x + j, y + i, color);
        }
      }
      else if(bg_color != color)
      {
        // 绘制背景
        if(size > 1)
        {
          LCD_Fill(x + j * size, y + i * size,
                  x + j * size + size - 1, y + i * size + size - 1,
                  bg_color);
        }
        else
        {
          LCD_DrawPoint(x + j, y + i, bg_color);
        }
      }
    }
  }
}

// 绘制字符串
void LCD_DrawString(uint16_t x, uint16_t y, const char *str, uint16_t color, uint16_t bg_color, uint8_t size)
{
  uint16_t current_x = x;
  uint16_t current_y = y;

  while(*str)
  {
    // 检查是否需要换行
    if(current_x + 8 * size > LCD_WIDTH)
    {
      current_x = x;
      current_y += 16 * size;

      // 检查是否超出屏幕高度
      if(current_y + 16 * size > LCD_HEIGHT)
        break;
    }

    // 绘制单个字符
    LCD_DrawChar(current_x, current_y, *str, color, bg_color, size);

    // 移动到下一个字符位置
    current_x += 8 * size;
    str++;
  }
}


void LCD_DrawCharHex(uint16_t x, uint16_t y, uint8_t c, uint16_t color, uint16_t bg_color, uint8_t size){
	if(c < 10) c = c + 0x30;
	else c = c + 0x37;
	LCD_DrawChar(x, y, c, color, bg_color, size);
}

// LCD初始化（ST7796初始化序列）
void LCD_Init(void)
{
  LCD_Reset();  // 复位

  // 初始化命令序列（参考ST7796 datasheet）
  LCD_WriteCmd(0x11);  // 退出睡眠模式
  HAL_Delay(120);

  LCD_WriteCmd(0x36);  // 设置内存访问方向
  LCD_WriteData(0b11101000);  // 竖屏：BGR，从上到下，从左到右（根据需求调整）

  LCD_WriteCmd(0x3A);  // 设置像素格式
  LCD_WriteData(0x05);  // 16位RGB565格式

  LCD_WriteCmd(0xB2);
  LCD_WriteData(0x08);  // 降低分频系数，提高帧率
  LCD_WriteData(0x08);
  LCD_WriteData(0x00);
  LCD_WriteData(0x33);
  LCD_WriteData(0x33);

  LCD_WriteCmd(0xB7);  // 网关控制
  LCD_WriteData(0x45);

  LCD_WriteCmd(0xBB);  // VCOM设置
  LCD_WriteData(0x19);

  LCD_WriteCmd(0xC0);  // LCM控制
  LCD_WriteData(0x2C);

  LCD_WriteCmd(0xC2);  // 电源控制
  LCD_WriteData(0x01);

  LCD_WriteCmd(0xC3);  // 电源控制
  LCD_WriteData(0x12);

  LCD_WriteCmd(0xC4);  // 电源控制
  LCD_WriteData(0x20);

  LCD_WriteCmd(0xC6);  // 帧率控制
  LCD_WriteData(0x0F);

  LCD_WriteCmd(0xD0);  // 电源控制
  LCD_WriteData(0xA4);
  LCD_WriteData(0xA1);

  LCD_WriteCmd(0xE0);  // 正伽马校正
  LCD_WriteData(0xD0);
  LCD_WriteData(0x04);
  LCD_WriteData(0x0D);
  LCD_WriteData(0x11);
  LCD_WriteData(0x13);
  LCD_WriteData(0x2B);
  LCD_WriteData(0x3F);
  LCD_WriteData(0x2C);
  LCD_WriteData(0x29);
  LCD_WriteData(0x25);
  LCD_WriteData(0x2B);
  LCD_WriteData(0x33);
  LCD_WriteData(0x3E);
  LCD_WriteData(0x00);
  LCD_WriteData(0x00);
  LCD_WriteData(0x00);

  LCD_WriteCmd(0xE1);  // 负伽马校正
  LCD_WriteData(0xD0);
  LCD_WriteData(0x04);
  LCD_WriteData(0x0C);
  LCD_WriteData(0x11);
  LCD_WriteData(0x13);
  LCD_WriteData(0x2C);
  LCD_WriteData(0x3F);
  LCD_WriteData(0x2D);
  LCD_WriteData(0x2E);
  LCD_WriteData(0x2E);
  LCD_WriteData(0x30);
  LCD_WriteData(0x38);
  LCD_WriteData(0x3E);
  LCD_WriteData(0x00);
  LCD_WriteData(0x00);
  LCD_WriteData(0x00);

  LCD_WriteCmd(0x20);  // 显示反转（根据屏幕实际显示调整，0x20为正常）

  LCD_WriteCmd(0x29);  // 开启显示
  HAL_Delay(100);

  //LCD_Fill(0, 0, LCD_WIDTH, LCD_HEIGHT, 0x0000);  // 填充黑色（320x480分辨率为例）
}

